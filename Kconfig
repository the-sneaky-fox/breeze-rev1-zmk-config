## Kconfig
```kconfig
choice PROSPECTOR_STATUS_SCREEN_LAYOUT
    prompt "Default status screen layout (shown at boot)"
    default PROSPECTOR_STATUS_SCREEN_CLASSIC

config PROSPECTOR_STATUS_SCREEN_CLASSIC
    bool "Classic layout"
    help
        Standard Prospector status screen

config PROSPECTOR_STATUS_SCREEN_RADII
    bool "Radii layout"
    help
        Colorful grid layout with rounded widgets

config PROSPECTOR_STATUS_SCREEN_FIELD
    bool "Field layout"
    help
        Minimal layout with flowing typing activity visualization

config PROSPECTOR_STATUS_SCREEN_OPERATOR
    bool "Operator layout"
    help
        Technical and information dense layout

endchoice

# Screens to compile in. The default screen chosen above is always enabled.
# Additional screens require the touchscreen feature (PROSPECTOR_TOUCHSCREEN)
# and are switched between via swipe gestures.

config PROSPECTOR_SCREEN_CLASSIC_ENABLED
    bool "Compile Classic screen"
    default y if PROSPECTOR_STATUS_SCREEN_CLASSIC

config PROSPECTOR_SCREEN_RADII_ENABLED
    bool "Compile Radii screen"
    default y if PROSPECTOR_STATUS_SCREEN_RADII
    depends on PROSPECTOR_TOUCHSCREEN

config PROSPECTOR_SCREEN_FIELD_ENABLED
    bool "Compile Field screen"
    default y if PROSPECTOR_STATUS_SCREEN_FIELD
    depends on PROSPECTOR_TOUCHSCREEN

config PROSPECTOR_SCREEN_OPERATOR_ENABLED
    bool "Compile Operator screen"
    default y if PROSPECTOR_STATUS_SCREEN_OPERATOR
    depends on PROSPECTOR_TOUCHSCREEN

config PROSPECTOR_TOUCHSCREEN
    bool "Enable touchscreen support (CST816S)"
    default n
    select INPUT
    help
      Enables touch input from the CST816S capacitive touch controller on
      the Waveshare 1.69" Touch LCD Module.

      When enabled, swipe gestures work anywhere on the screen:
      - left/right : cycle through compiled-in status screens (slide anim)
      - up/down    : raise/lower display brightness (10% steps)

config PROSPECTOR_ROTATE_DISPLAY_180
    bool "Rotate the display 180 degrees"
    default n

config PROSPECTOR_SHOW_MODIFIERS
    bool "Display modifier key indicators (Win/Cmd, Alt/Opt, Ctrl, Shift)"
    default y

config PROSPECTOR_SHOW_INACTIVE_MODIFIERS
    bool "Show inactive modifier indicators (dim when not pressed)"
    default y
    depends on PROSPECTOR_SHOW_MODIFIERS
    help
      When enabled, inactive modifiers are shown with a dim color.
      When disabled, inactive modifiers are hidden completely.
      Only affects classic and field layouts.

config PROSPECTOR_MODIFIER_ORDER
    string "Modifier display order"
    default "GACS"
    depends on PROSPECTOR_SHOW_MODIFIERS
    help
      Order of modifier indicators. Use exactly 4 characters:
      G=GUI/Win/Cmd, A=Alt/Opt, C=Control, S=Shift.
      Each character must appear exactly once.

choice PROSPECTOR_MODIFIER_OS
    prompt "Modifier key style"
    default PROSPECTOR_MODIFIER_OS_WINDOWS
    depends on PROSPECTOR_SHOW_MODIFIERS

config PROSPECTOR_MODIFIER_OS_GENERIC
    bool "Generic (CTRL, ALT, GUI, SHFT)"

config PROSPECTOR_MODIFIER_OS_WINDOWS
    bool "Windows (WIN, ALT, CTRL, SHFT)"

config PROSPECTOR_MODIFIER_OS_MAC
    bool "Mac (CMD, OPT, CTRL, SHFT)"

endchoice

config PROSPECTOR_USE_AMBIENT_LIGHT_SENSOR
    bool "Use ambient light sensor for auto brightness"
    default y

config PROSPECTOR_FIXED_BRIGHTNESS
    int "Fixed display brightness"
    default 50
    range 1 100
    depends on !PROSPECTOR_USE_AMBIENT_LIGHT_SENSOR

config PROSPECTOR_LAYER_NAME_UPPERCASE
    bool "Display layer names in uppercase"
    default y
    help
      When enabled, layer names will be converted to uppercase for display.
```

## boards/shields/prospector_adapter/Kconfig.defconfig
```kconfig
if SHIELD_PROSPECTOR_ADAPTER

config ZMK_SPLIT_BLE_CENTRAL_BATTERY_LEVEL_FETCHING
    default y

config ZMK_HID_INDICATORS
    default y

config ZMK_DISPLAY
   default y

choice ZMK_DISPLAY_STATUS_SCREEN
    default ZMK_DISPLAY_STATUS_SCREEN_CUSTOM
endchoice

# With the touchscreen enabled, multiple screen trees live in the LVGL heap.
config LV_Z_MEM_POOL_SIZE
    default 32768 if PROSPECTOR_TOUCHSCREEN

# Run the input thread at a higher priority than the display thread so touch
# events are not starved during rendering.
config INPUT_THREAD_PRIORITY_OVERRIDE
    default y if PROSPECTOR_TOUCHSCREEN

config INPUT_THREAD_PRIORITY
    default 4 if PROSPECTOR_TOUCHSCREEN

rsource "src/layouts/*/Kconfig.defconfig"

choice ZMK_DISPLAY_WORK_QUEUE
    default ZMK_DISPLAY_WORK_QUEUE_DEDICATED
endchoice

choice ST7789V_PIXEL_FORMAT
	default ST7789V_RGB565
endchoice

config LV_Z_VDB_SIZE
    default 50

config LV_Z_DOUBLE_VDB
    default y

config LV_Z_FLUSH_THREAD
    default y

config LV_Z_MEM_POOL_SIZE
    default 16384

config LV_DPI_DEF
    default 261

config LV_Z_BITS_PER_PIXEL
	default 16

choice LV_COLOR_DEPTH
	default LV_COLOR_DEPTH_16
endchoice

config LV_COLOR_16_SWAP
	default y

choice LV_FONT_DEFAULT
    default LV_FONT_DEFAULT_MONTSERRAT_20
endchoice

config PWM
    default y

config LED
    default y

config PROSPECTOR_USE_AMBIENT_LIGHT_SENSOR
    select SENSOR
    select APDS9960

endif
```

## config/boards/shields/AfternoonLabsBreezeRev1/Kconfig.defconfig
```kconfig
if SHIELD_BREEZE_REV1_DONGLE

config ZMK_KEYBOARD_NAME
	default "Forest Breeze"

config ZMK_SPLIT_ROLE_CENTRAL
	default y

config ZMK_SPLIT_BLE_CENTRAL_PERIPHERALS
	default 2

config BT_MAX_CONN
	default 7

config BT_MAX_PAIRED
	default 7

config ZMK_HID_INDICATORS
	default y

config INPUT_THREAD_PRIORITY_OVERRIDE
	default y if PROSPECTOR_TOUCHSCREEN

config INPUT_THREAD_PRIORITY
	default 4 if PROSPECTOR_TOUCHSCREEN

config ZMK_STUDIO
	default y

config ZMK_STUDIO_LOCKING
	default n

config LV_Z_MEM_POOL_SIZE
	default 65536 if PROSPECTOR_TOUCHSCREEN

config LV_Z_VDB_SIZE
	default 20

endif

if SHIELD_BREEZE_REV1_LEFT

config ZMK_KEYBOARD_NAME
	default "Forest Breeze"

config ZMK_SPLIT_ROLE_CENTRAL
	default y

endif

if SHIELD_BREEZE_REV1_LEFT || SHIELD_BREEZE_REV1_RIGHT

config ZMK_SLEEP
	default y

config ZMK_IDLE_TIMEOUT
	default 15000

config ZMK_IDLE_SLEEP_TIMEOUT
	default 600000

config ZMK_BATTERY_REPORT_INTERVAL
	default 120

config ZMK_EXT_POWER
	default n

endif

if SHIELD_BREEZE_REV1_DONGLE || SHIELD_BREEZE_REV1_LEFT || SHIELD_BREEZE_REV1_RIGHT

config ZMK_SPLIT
	default y

endif
```

## config/west.yml
```yaml
manifest:
  remotes:
    - name: zmkfirmware
      url-base: https://github.com/zmkfirmware
    - name: olafkrawczyk
      url-base: https://github.com/olafkrawczyk
  projects:
    - name: zmk
      remote: zmkfirmware
      revision: main
      import: app/west.yml
    - name: prospector-zmk-module
      remote: olafkrawczyk
      revision: feat/touch-swipe-screens
  self:
    path: config
```
